/*
 "Pill Dispenser Monitor - Part 1 - Touch Monitor"

  The application is used to for people with special needs like elderly people who live in a assited living facility.
  It helps them take take the correct pill of the day and notifies the family when:
    - When the temperature of pill dispenser is too hot and needs to be shaded.
    - When the elder takes the wrong pill.
    - When the elder takes the right pill.
    - When the day ends, it sends an update if the right pill was not taken.
  
  The circuit:
  Input  - temperature (thermometer), touch (capacity from pins).
  Output - speaker (speech), LED onboard Neopixels to tell the status
           and via Blynk and Integromat Android and Telegram messages.

  Video link: https://youtu.be/kLSAgJ6cDpY.
  Created By:
  Eitan Alroy 316486497
  Lior Baruch 327156998
*/

#define BLYNK_PRINT SerialUSB
#define BLYNK_DEBUG SerialUSB
#define EspSerial Serial1
#define ESP8266_BAUD 115200

#include <ESP8266_Lib.h>
#include <BlynkSimpleShieldEsp8266.h>
#include <Adafruit_CircuitPlayground.h>
#include <TimeLib.h>
#include <WidgetRTC.h>

char auth[] = "insert Blynk authentication here";
char ssid[] = "insert Wifi SSID here";
char pass[] = "insert Wifi password here";


// Constants used for speach during high temperature
const uint8_t spDANGER[]            PROGMEM = {0x2D,0xBF,0x21,0x92,0x59,0xB4,0x9F,0xA2,0x87,0x10,0x8E,0xDC,0x72,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0xFF,0x03};
const uint8_t spTEMPERATURE[]       PROGMEM = {0x0A,0x38,0xDE,0x32,0x00,0x2F,0xBB,0x37,0xBF,0x59,0x57,0x76,0x6F,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0xFE,0x1F};
const uint8_t spTOO[]               PROGMEM = {0x02,0xD8,0x51,0x3C,0x00,0xC7,0x7A,0x18,0x20,0x85,0xE2,0xE5,0x16,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0x75,0xF2};
const uint8_t spHIGH[]              PROGMEM = {0x28,0x5A,0x1C,0x01,0x45,0x7B,0x94,0x32,0x87,0xB0,0x32,0x8E,0xB2,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0xFE,0x7F};
const uint8_t spTHAT_IS_INCORRECT[] PROGMEM = {0xA5,0x2B,0x51,0x25,0xC8,0x7C,0x9F,0x2A,0x78,0xCD,0xD0,0x7A,0x7A,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0x00,0x00};
const uint8_t spTHAT_IS_RIGHT[]     PROGMEM = {0xA6,0xD1,0xC6,0x25,0x68,0x52,0x97,0xCE,0x5B,0x8A,0xE0,0xE8,0x74,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0x00,0x00};

// Timers for correct flow of information to the server
int blynkLoopInterval = 1000;
int integromantLoopInterval = 30000;

int previousMillisBlynkLoopDelay = 0;
int previousMillisIntegromantLoopDelay = 0;

//Virtual Pins used in Blynk app
//V0 - Post (Current Temperature, Temperature Status), V1 - Temperature Value Blynk
//V2 - Post (Right Pill, Wrong Pill, End Day), V3 - Receive Wrong Pill, V4 - Reset Pills, V5 - Pill Status
byte capsensePins[] = {A0, A1, A2, A3, A4, A5};
int touchIndication = 650;

//avg
double avgTouch [] = {0, 0, 0, 0, 0, 0};
double avgTemperature = 0;

//max
double maxTouch [] = {0, 0, 0, 0, 0, 0};
double maxTemperature = 0;

//pills
bool tookRightPill = false;
bool tookWrongPill = false;
bool notifiedRightPill = false;
bool notifiedWrongPill = false;

//temperature
bool tempOverheat = false;
int overheatTemperature = 40;

//time
int currWeekday = 0;

// Wifi and widget inits
ESP8266 wifi(&EspSerial);
WidgetRTC rtc;
WidgetLED led(V5);

void setup() {
  CircuitPlayground.begin();
  SerialUSB.begin(9600);
  EspSerial.begin(ESP8266_BAUD);
  delay(10);
  Blynk.begin(auth, wifi, ssid, pass);
  led.on();
  led.setValue(255); // Indecates in Blynk app default color
  setPixelsColors(); // Starts in the default colors
}

void loop() {
  Blynk.run();
  
  updateMax(); // updated the max values of the loop
  
  unsigned long currentMillis = millis();

  // Waits for a dedicated time for a Blynk loop
  if((currentMillis - previousMillisBlynkLoopDelay) > blynkLoopInterval){
    avgTemperature = 0.8 * avgTemperature + 0.2 * CircuitPlayground.temperature(); // updates avg temp
    Blynk.virtualWrite(V1, avgTemperature); // sends to Blynk temp gauge
    updateAvgTouched(); // updates the touch cap avgs
    previousMillisBlynkLoopDelay = currentMillis;
  }

  // Waits for a dedicated time for a Integromant loop
  if(currentMillis - previousMillisIntegromantLoopDelay > integromantLoopInterval){
    checkStatus();
    resetMaxToucedArray();
    maxTemperature = 0;
    previousMillisIntegromantLoopDelay = currentMillis;
  }
  delay(100);
}

// Checks the current touch or heat status and updates the weekday
void checkStatus(){
  if(currWeekday != weekday()) { // check if day changed
      if(currWeekday != 0) {
        dayChanged();
      }
      currWeekday = weekday();
  }
  checkOverheating();
  checkTouched();
}

// Checks the temp and if too high notifies the integromant
void checkOverheating() {
  if(!tempOverheat && maxTemperature > overheatTemperature){ // Temp Overheat
    Blynk.virtualWrite(V0, maxTemperature, true);
    tempOverheat = true;
    setPixelsColors();
  }
  if(tempOverheat && maxTemperature <= overheatTemperature) { // Temp Cooled
    tempOverheat = false;
    setPixelsColors();
  }
}

// If the day has changed and right pill wasn't taken, sends message to integromant
void dayChanged(){
   if(!tookRightPill) {
      Blynk.virtualWrite(V2, false, tookWrongPill, true);
   }
   resetValues();
}

// Resets all pill flags
void resetValues() {
  tookRightPill = false;
  tookWrongPill = false;
  notifiedRightPill = false;
  notifiedWrongPill = false;
}

// Checks touch cap levels
void checkTouched(){
  Serial.print(currWeekday);
  for(int i = 0; i < sizeof(maxTouch)/sizeof(maxTouch[0]); i++) { // loops through all available cap pins
    if(maxTouch[i] > touchIndication){
        if((i + 1) == currWeekday && !notifiedRightPill){
            tookRightPill = true; // check duplication
            Blynk.virtualWrite(V2, tookRightPill, tookWrongPill, false);
            notifiedRightPill = true;
            setPixelsColors();
            break;
        } else if((i + 1) != currWeekday && !notifiedWrongPill) {
            tookWrongPill = true;
            Blynk.virtualWrite(V2, tookRightPill, tookWrongPill, false);
            notifiedWrongPill = true;
            setPixelsColors();
            break;
        }
     }
  }
}

int updateAvgTouched(){
  for(int i = 0; i < min(sizeof(avgTouch)/sizeof(avgTouch[0]),sizeof(capsensePins)/sizeof(capsensePins[0])); i++) { // loops through all available cap pins
    avgTouch[i] = avgTouch[i] * 0.8 + 0.2 * CircuitPlayground.readCap(capsensePins[i]); // updates the average capacity for pins
  }
}

void updateMax(){
  updateMaxTouched();
  maxTemperature = max(maxTemperature, avgTemperature);
}

void resetMaxToucedArray() {
  for(int i = 0; i < sizeof(maxTouch)/sizeof(maxTouch[0]); i++) { // loops through all available cap pins
    maxTouch[i] = 0;
  }
}

void updateMaxTouched(){
  for(int i = 0; i < sizeof(maxTouch)/sizeof(maxTouch[0]); i++) { // loops through all available cap pins
     maxTouch[i] = max(maxTouch[i], avgTouch[i]);
  }
}

// Sets the coorect colors on the Neopixels based on flags
void setPixelsColors() {
  if(tempOverheat) { // device is in hot temp
    setAllPixelsColors(255, 0, 0); // Sets colors to red
    Blynk.setProperty(V5, "color", "#FF0000");
    CircuitPlayground.speaker.say(spDANGER);
    CircuitPlayground.speaker.say(spTEMPERATURE);
    CircuitPlayground.speaker.say(spTOO);
    CircuitPlayground.speaker.say(spHIGH);
  } else if(tookWrongPill) {
      setAllPixelsColors(255, 255, 0); // Sets colors to yellow
      Blynk.setProperty(V5, "color", "#FFFF00");
      CircuitPlayground.speaker.say(spTHAT_IS_INCORRECT);
  } else if (tookRightPill) {
      setAllPixelsColors(0, 255, 0); // Sets colors to green
      Blynk.setProperty(V5, "color", "#00FF00");
      CircuitPlayground.speaker.say(spTHAT_IS_RIGHT);
  } else {
      setAllPixelsColors(0, 0, 255); // Sets colors to blue
      Blynk.setProperty(V5, "color", "#0000FF");
  }
}

void setAllPixelsColors(int red, int green , int blue) {
  for (int i = 0; i < 10; ++i) { 
    CircuitPlayground.setPixelColor(i, red, green, blue);
  }
}

BLYNK_CONNECTED() {
  // Synchronize time on connection
  rtc.begin();
}

BLYNK_WRITE(V3) {
 tookWrongPill = param.asInt();
 notifiedWrongPill = param.asInt();
 setPixelsColors();
}

BLYNK_WRITE(V4) {
 resetValues();
 setPixelsColors();
}
